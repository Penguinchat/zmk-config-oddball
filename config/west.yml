## config/west.yml
```yaml
manifest:
  remotes:
    - name: zmkfirmware
      url-base: https://github.com/petejohanson
    - name: badjeff
      url-base: https://github.com/badjeff
    - name: Penguinchat
      url-base: https://github.com/Penguinchat
  projects:
    - name: zmk
      remote: zmkfirmware
      revision: feat/pointers-with-input-processors
      import: app/west.yml
    - name: zmk-pmw3610-driver
      remote: badjeff
      revision: main
    - name: zmk-split-peripheral-input-relay
      remote: badjeff
      revision: main
    - name: zmk-input-behavior-listener
      remote: badjeff
      revision: main
    - name: prospector-zmk-module
      remote: Penguinchat
      revision: support_nicenano
  self:
    path: config
```
